## src/custom/generated-slicc/Kconfig
```kconfig
config PROTOCOL
    default "GENERATED" if RUBY_PROTOCOL_GENERATED
    default "MOESI_CMP_directory_edit" if RUBY_PROTOCOL_MOESI_CMP_DIRECTORY_EDIT
    default "MESI_two_generated" if RUBY_MESI_two_generated
    default "MSI_unord" if RUBY_MSI_unord
    default "MESI_unord" if RUBY_MESI_unord
    default "MESI_unord_CXL" if RUBY_MESI_unord_CXL
    default "MSI_unord_CXL" if RUBY_MSI_unord_CXL
    default "MOESI_unord_CXL" if RUBY_MOESI_unord_CXL
    default "MESI_CXL_MSI" if RUBY_MESI_CXL_MSI
    default "MESI_CXL_MOESI" if RUBY_MESI_CXL_MOESI
    default "MESI_CXL_MESIF" if RUBY_MESI_CXL_MESIF
    default "nicolo-MSI_unord" if RUBY_MSI_unord_NIC
    default "nicolo-MESI_unord" if RUBY_MESI_unord_NIC



cont_choice "Ruby protocol"
    config RUBY_PROTOCOL_GENERATED
        bool "GENERATED"
    config RUBY_PROTOCOL_MOESI_CMP_DIRECTORY_EDIT
        bool "MOESI CMP directory edit"
    config RUBY_MESI_two_generated
        bool "MESI_two_generated"
    config RUBY_MSI_unord
        bool "MSI_unord"
    config RUBY_MESI_unord
        bool "MESI_unord"
    config RUBY_MESI_unord_CXL
        bool "MESI_unord_CXL"
    config RUBY_MSI_unord_CXL
        bool "MSI_unord_CXL"
    config RUBY_MOESI_unord_CXL
        bool "MOESI_unord_CXL"
    config RUBY_MESI_CXL_MSI
        bool "MESI_CXL_MSI"
    config RUBY_MESI_CXL_MOESI
        bool "MESI_CXL_MOESI"
    config RUBY_MESI_CXL_MESIF
        bool "MESI_CXL_MESIF"
    config RUBY_MESI_unord_NIC
        bool "nicolo-MESI_unord"
    config RUBY_MSI_unord_NIC
        bool "nicolo-MSI_unord"
endchoice
```

## src/custom/post-CGO/Kconfig
```kconfig
config PROTOCOL
    default "MESI_one_level_synth" if RUBY_MESI_UNORD_ONE_LEVEL_SYNTH
    default "MESI_two_level_synth" if RUBY_MESI_UNORD_TWO_LEVEL_SYNTH
    default "MESI_three_level_synth" if RUBY_MESI_UNORD_THREE_LEVEL_SYNTH
    default "MOESI_one_level_synth" if RUBY_MOESI_UNORD_ONE_LEVEL_SYNTH
    default "MOESI_two_level_synth" if RUBY_MOESI_UNORD_TWO_LEVEL_SYNTH
    default "MOESI_three_level_synth" if RUBY_MOESI_UNORD_THREE_LEVEL_SYNTH
    default "MESIF_one_level_synth" if RUBY_MESIF_UNORD_ONE_LEVEL_SYNTH


cont_choice "Ruby protocol"
    config RUBY_MESI_UNORD_ONE_LEVEL_SYNTH
        bool "MESI_one_level_synth"
    config RUBY_MESI_UNORD_TWO_LEVEL_SYNTH
        bool "MESI_two_level_synth"
    config RUBY_MESI_UNORD_THREE_LEVEL_SYNTH
        bool "MESI_three_level_synth"
    config RUBY_MOESI_UNORD_THREE_LEVEL_SYNTH
        bool "MOESI_three_level_synth"
    config RUBY_MOESI_UNORD_TWO_LEVEL_SYNTH
        bool "MOESI_two_level_synth"
    config RUBY_MOESI_UNORD_ONE_LEVEL_SYNTH
        bool "MOESI_one_level_synth"
    config RUBY_MESIF_UNORD_ONE_LEVEL_SYNTH
        bool "MESIF_one_level_synth"
endchoice
```

## src/custom/post-CGO/MESI-MESIF/Kconfig
```kconfig
config PROTOCOL
    default "MESI_MESIF" if RUBY_MESI_MESIF


cont_choice "Ruby protocol"
    config RUBY_MESI_MESIF
        bool "MESI_MESIF"
endchoice
```

## src/custom/post-CGO/MESI-MOESI/Kconfig
```kconfig
config PROTOCOL
    default "MESI_MOESI" if RUBY_MESI_MOESI


cont_choice "Ruby protocol"
    config RUBY_MESI_MOESI
        bool "MESI_MOESI"
endchoice
```
